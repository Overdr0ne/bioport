## CMakeLists.txt
```
# SPDX-License-Identifier: Apache-2.0

cmake_minimum_required(VERSION 3.13.1)
project(bioport
  VERSION 0.1
  DESCRIPTION "A platform for building interface devices")

include($ENV{ZEPHYR_BASE}/cmake/app/boilerplate.cmake NO_POLICY_SCOPE)

set(CMAKE_EXPORT_COMPILE_COMMANDS ON)
set(CMAKE_BUILD_TYPE Debug)
set(CMAKE_C_FLAGS_DEBUG "-O0 -g")
include_directories("src/invensense/driver/include"
  "src/invensense/driver/eMPL-hal"
  "src/invensense/mpl"
  "src/invensense"
  "src/invensense/mpl-static/liblibmplmpu_m4_hardfp"
  "src/invensense/mllite")
add_compile_definitions(MPU6050 EMPL USE_DMP ZEPHYR)

find_library(MPL_LIB libmplmpu ./src/invensense)

FILE(GLOB app_sources "src/*.c" "src/invensense/eMPL-hal/*.c" "src/invensense/mllite/*.c" "src/*.cpp" "src/mpu6050/*.cpp" "src/I2Cdev/*.cpp")
target_sources(app PRIVATE
  ${app_sources}
  )

target_link_libraries(app LINK_PUBLIC ${MPL_LIB})
```

## prj.conf
```kconfig
# Incresed stack due to settings API usage
CONFIG_SYSTEM_WORKQUEUE_STACK_SIZE=2048

CONFIG_NEWLIB_LIBC=y
CONFIG_FLOAT=y

CONFIG_BT=y
CONFIG_BT_PRIVACY=y
CONFIG_BT_DEBUG_LOG=y
CONFIG_BT_SMP=y
CONFIG_BT_PERIPHERAL=y
CONFIG_BT_GATT_DIS=y
CONFIG_BT_GATT_BAS=y
CONFIG_BT_DEVICE_NAME="sam bio-mouse"
CONFIG_BT_DEVICE_APPEARANCE=962
CONFIG_BT_SETTINGS=y

CONFIG_FLASH=y
CONFIG_FLASH_PAGE_LAYOUT=y
CONFIG_FLASH_MAP=y
CONFIG_FCB=y
CONFIG_SETTINGS=y
CONFIG_SETTINGS_FCB=y

CONFIG_SENSOR_LOG_LEVEL_DBG=y
# CONFIG_STDOUT_CONSOLE=y
CONFIG_LOG=y
CONFIG_LOG_DEFAULT_LEVEL=3
CONFIG_PRINTK=y

CONFIG_I2C=y
CONFIG_MPU6050=y
CONFIG_MPU6050_TRIGGER=y
CONFIG_MPU6050_TRIGGER_OWN_THREAD=y
CONFIG_MPU6050_GPIO_PIN_NUM=31

CONFIG_ADC=y
CONFIG_ADC_ASYNC=y
CONFIG_ADC_0=y
CONFIG_ADC_LOG_LEVEL_INF=y
```

## src/main.c
```c
/* main.c - Application main entry point */

/*
 * Copyright (c) 2016 Intel Corporation
 *
 * SPDX-License-Identifier: Apache-2.0
 */

#include <errno.h>
#include <stddef.h>
#include <string.h>
#include <sys/byteorder.h>
#include <sys/printk.h>
#include <zephyr.h>
#include <zephyr/types.h>

#include <settings/settings.h>

#include <device.h>
#include <drivers/gpio.h>
#include <drivers/sensor.h>

#include <bluetooth/bluetooth.h>
#include <bluetooth/conn.h>
#include <bluetooth/gatt.h>
#include <bluetooth/hci.h>
#include <bluetooth/uuid.h>

#include <logging/log.h>

#include "analog.h"
#include "bioport.h"
#include "ble.h"
#include "button.h"
/* #include "mpu.h" */

#include "invensense/driver/eMPL/inv_mpu.h"
#include "invensense/driver/eMPL/inv_mpu_dmp_motion_driver.h"
#include "invensense/mllite/invensense.h"
#include "invensense/mllite/mpl.h"
#include "invensense/mpl/invensense_adv.h"
#include "invensense/eMPL-hal/eMPL_outputs.h"
#include "invensense/driver/include/mltypes.h"
#include "invensense/driver/include/mpu.h"
#include "invensense/driver/include/log.h"
#include "logging/log_core.h"
/* #include "invensense/stm32L/packet.h" */

/* unsigned char *mpl_key = (unsigned char*)"eMPL 5.1"; */
/* #define ACCEL_ON        (0x01) */
/* #define GYRO_ON         (0x02) */
/* #define COMPASS_ON      (0x04) */

/* #define MOTION          (0) */
/* #define NO_MOTION       (1) */

/* /\* Starting sampling rate. *\/ */
/* #define DEFAULT_MPU_HZ  (20) */

/* /\* #define FLASH_SIZE      (512) *\/ */
/* /\* #define FLASH_MEM_START ((void*)0x1800) *\/ */

/* #define PEDO_READ_MS    (1000) */
/* #define TEMP_READ_MS    (500) */
/* #define COMPASS_READ_MS (100) */

void main(void) {
  int ret;
  struct device *gpio_dev;
  struct device *mpu_dev;
  struct device *adc_dev;
  static s16_t m_sample_buffer[ANALOG_BUFFER_SIZE];
  const struct adc_sequence sequence = {
      .channels = BIT(ADC_1ST_CHANNEL_ID),
      /* .channels = BIT(ADC_2ND_CHANNEL_ID), */
      .buffer = m_sample_buffer,
      .buffer_size = sizeof(m_sample_buffer),
      .resolution = ADC_RESOLUTION,
  };

  ble_init();

  /*
    gpio_dev = device_get_binding(GPIO_PORT);
    if (!gpio_dev) {
    printk("error\n");
    return;
    }
    button_init(gpio_dev);
  */
  printk("initializing...\n");
  mpu_dev = device_get_binding("MPU6050");
  mpu_init(mpu_dev);

  /* adc_dev = init_adc(m_sample_buffer); */
  /* if (!adc_dev) { */
  /*   return; */
  /* } */

  /* while (1) { */
  /*   ret = adc_read(adc_dev, &sequence); */
  /*   if (!ret) { */
  /*     printk("adc_read: error %d\n", ret); */
  /*   } */
  /*   k_sleep(MSEC_PER_SEC / 4); */
  /*   adc_print_samples(1, m_sample_buffer); */
  /* } */
}

/* void main() { */
/*   inv_error_t result; */
/*   unsigned char accel_fsr, new_temp = 0; */
/*   unsigned short gyro_rate, gyro_fsr; */
/*   unsigned long timestamp; */
/*   struct int_param_s int_param; */

/*   /\* LOG_MODULE_REGISTER(bioport, LOG_LEVEL_ERR); *\/ */

/*   result = mpu_init(&int_param); */
/*   if (result) { */
/*     MPL_LOGE("Could not initialize gyro.\n"); */
/*   } */

/*   /\* If you're not using an MPU9150 AND you're not using DMP features, this */
/*    * function will place all slaves on the primary bus. */
/*    * mpu_set_bypass(1); */
/*    *\/ */

/*   result = inv_init_mpl(); */
/*   if (result) { */
/*     MPL_LOGE("Could not initialize MPL.\n"); */
/*   } */

/*   /\* Compute 6-axis and 9-axis quaternions. *\/ */
/*   inv_enable_quaternion(); */
/*   inv_enable_9x_sensor_fusion(); */
/*   /\* The MPL expects compass data at a constant rate (matching the rate */
/*    * passed to inv_set_compass_sample_rate). If this is an issue for your */
/*    * application, call this function, and the MPL will depend on the */
/*    * timestamps passed to inv_build_compass instead. */
/*    * */
/*    * inv_9x_fusion_use_timestamps(1); */
/*    *\/ */

/*   /\* Update gyro biases when not in motion. */
/*    * WARNING: These algorithms are mutually exclusive. */
/*    *\/ */
/*   inv_enable_fast_nomot(); */
/*   /\* inv_enable_motion_no_motion(); *\/ */
/*   /\* inv_set_no_motion_time(1000); *\/ */

/*   /\* Update gyro biases when temperature changes. *\/ */
/*   inv_enable_gyro_tc(); */

/*   /\* This algorithm updates the accel biases when in motion. A more accurate */
/*    * bias measurement can be made when running the self-test (see case 't' in */
/*    * handle_input), but this algorithm can be enabled if the self-test can't */
/*    * be executed in your application. */
/*    * */
/*    * inv_enable_in_use_auto_calibration(); */
/*    *\/ */

/* #ifdef COMPASS_ENABLED */
/*   /\* Compass calibration algorithms. *\/ */
/*   inv_enable_vector_compass_cal(); */
/*   inv_enable_magnetic_disturbance(); */
/* #endif */
/*   /\* If you need to estimate your heading before the compass is calibrated, */
/*    * enable this algorithm. It becomes useless after a good figure-eight is */
/*    * detected, so we'll just leave it out to save memory. */
/*    * inv_enable_heading_from_gyro(); */
/*    *\/ */

/*   /\* Allows use of the MPL APIs in read_from_mpl. *\/ */
/*   inv_enable_eMPL_outputs(); */

/*   result = inv_start_mpl(); */
/*   if (result == INV_ERROR_NOT_AUTHORIZED) { */
/*     while (1) { */
/*       MPL_LOGE("Not authorized.\n"); */
/*     } */
/*   } */
/*   if (result) { */
/*     MPL_LOGE("Could not start the MPL.\n"); */
/*   } */

/*   /\* Get/set hardware configuration. Start gyro. *\/ */
/*   /\* Wake up all sensors. *\/ */
/* #ifdef COMPASS_ENABLED */
/*   mpu_set_sensors(INV_XYZ_GYRO | INV_XYZ_ACCEL | INV_XYZ_COMPASS); */
/* #else */
/*   mpu_set_sensors(INV_XYZ_GYRO | INV_XYZ_ACCEL); */
/* #endif */
/*   /\* Push both gyro and accel data into the FIFO. *\/ */
/*   mpu_configure_fifo(INV_XYZ_GYRO | INV_XYZ_ACCEL); */
/*   mpu_set_sample_rate(DEFAULT_MPU_HZ); */
/* #ifdef COMPASS_ENABLED */
/*   /\* The compass sampling rate can be less than the gyro/accel sampling rate. */
/*    * Use this function for proper power management. */
/*    *\/ */
/*   mpu_set_compass_sample_rate(1000 / COMPASS_READ_MS); */
/* #endif */
/*   /\* Read back configuration in case it was set improperly. *\/ */
/*   mpu_get_sample_rate(&gyro_rate); */
/*   mpu_get_gyro_fsr(&gyro_fsr); */
/*   mpu_get_accel_fsr(&accel_fsr); */
/* #ifdef COMPASS_ENABLED */
/*   mpu_get_compass_fsr(&compass_fsr); */
/* #endif */
/*   /\* Sync driver configuration with MPL. *\/ */
/*   /\* Sample rate expected in microseconds. *\/ */
/*   inv_set_gyro_sample_rate(1000000L / gyro_rate); */
/*   inv_set_accel_sample_rate(1000000L / gyro_rate); */
/* #ifdef COMPASS_ENABLED */
/*   /\* The compass rate is independent of the gyro and accel rates. As long as */
/*    * inv_set_compass_sample_rate is called with the correct value, the 9-axis */
/*    * fusion algorithm's compass correction gain will work properly. */
/*    *\/ */
/*   inv_set_compass_sample_rate(COMPASS_READ_MS * 1000L); */
/* #endif */
/*   /\* Set chip-to-body orientation matrix. */
/*    * Set hardware units to dps/g's/degrees scaling factor. */
/*    *\/ */
/*   inv_set_gyro_orientation_and_scale( */
/*       inv_orientation_matrix_to_scalar(gyro_pdata.orientation), */
/*       (long)gyro_fsr << 15); */
/*   inv_set_accel_orientation_and_scale( */
/*       inv_orientation_matrix_to_scalar(gyro_pdata.orientation), */
/*       (long)accel_fsr << 15); */
/* #ifdef COMPASS_ENABLED */
/*   inv_set_compass_orientation_and_scale( */
/*       inv_orientation_matrix_to_scalar(compass_pdata.orientation), */
/*       (long)compass_fsr << 15); */
/* #endif */
/*   /\* Initialize HAL state variables. *\/ */
/* #ifdef COMPASS_ENABLED */
/*   hal.sensors = ACCEL_ON | GYRO_ON | COMPASS_ON; */
/* #else */
/*   hal.sensors = ACCEL_ON | GYRO_ON; */
/* #endif */
/*   hal.dmp_on = 0; */
/*   hal.report = 0; */
/*   hal.rx.cmd = 0; */
/*   hal.next_pedo_ms = 0; */
/*   hal.next_compass_ms = 0; */
/*   hal.next_temp_ms = 0; */

/* } */
```

## src/analog.c
```c
#include "analog.h"

const struct adc_sequence sequence;

static const struct adc_channel_cfg m_1st_channel_cfg = {
    .gain = ADC_GAIN,
    .reference = ADC_REFERENCE,
    .acquisition_time = ADC_ACQUISITION_TIME,
    .channel_id = ADC_1ST_CHANNEL_ID,
#if defined(CONFIG_ADC_CONFIGURABLE_INPUTS)
    .input_positive = ADC_1ST_CHANNEL_INPUT,
#endif
};
#if defined(ADC_2ND_CHANNEL_ID)
static const struct adc_channel_cfg m_2nd_channel_cfg = {
    .gain = ADC_GAIN,
    .reference = ADC_REFERENCE,
    .acquisition_time = ADC_ACQUISITION_TIME,
    .channel_id = ADC_2ND_CHANNEL_ID,
#if defined(CONFIG_ADC_CONFIGURABLE_INPUTS)
    .input_positive = ADC_2ND_CHANNEL_INPUT,
#endif
};
#endif /* defined(ADC_2ND_CHANNEL_ID) */

struct device *init_adc(s16_t *m_sample_buffer) {
  int ret;
  struct device *adc_dev = device_get_binding(ADC_DEVICE_NAME);

  adc_dev = device_get_binding(ADC_DEVICE_NAME);
  if (!adc_dev) {
    printk("failed to get adc dt binding\n");
  }

  ret = adc_channel_setup(adc_dev, &m_1st_channel_cfg);
  if (ret != 0) {
    printk("Setting up of the first channel failed with code %d", ret);
  }

#if defined(ADC_2ND_CHANNEL_ID)
  ret = adc_channel_setup(adc_dev, &m_2nd_channel_cfg);
  if (ret != 0) {
    printk("Setting up of the second channel failed with code %d", ret);
  }
#endif /* defined(ADC_2ND_CHANNEL_ID) */

  (void)memset(m_sample_buffer, 0, sizeof(m_sample_buffer));

  return adc_dev;
}

void adc_print_samples(int expected_count, s16_t *m_sample_buffer) {
  int i;

  printk("Samples read: ");
  for (i = 0; i < ANALOG_BUFFER_SIZE; i++) {
    s16_t sample_value = m_sample_buffer[i];

    printk("0x%04x ", sample_value);
    if (i < expected_count) {
      if (sample_value == 0) {
        printk("[%u] should be non-zero", i);
      }
    } else {
      if (sample_value != 0) {
        printk("[%u] should be zero", i);
      }
    }
  }
  printk("\n");
}
```

## src/analog.h
```c
#ifndef __ANALOG_H_
#define __ANALOG_H_

#include <drivers/adc.h>
#include <hal/nrf_saadc.h>
#include <string.h>

#define ADC_DEVICE_NAME DT_ADC_0_NAME
#define ADC_RESOLUTION 10
#define ADC_GAIN ADC_GAIN_1_6
#define ADC_REFERENCE ADC_REF_INTERNAL
#define ADC_ACQUISITION_TIME ADC_ACQ_TIME(ADC_ACQ_TIME_MICROSECONDS, 10)
#define ADC_1ST_CHANNEL_ID 0
#define ADC_1ST_CHANNEL_INPUT NRF_SAADC_INPUT_AIN1
#define ADC_2ND_CHANNEL_ID 2
#define ADC_2ND_CHANNEL_INPUT NRF_SAADC_INPUT_AIN2

#define ANALOG_BUFFER_SIZE 6

struct device *init_adc(s16_t *m_sample_buffer);
void adc_print_samples(int expected_count, s16_t *m_sample_buffer);

#endif // __ANALOG_H_
```

## src/bioport.h
```c
#ifndef __BIOPORT_H_
#define __BIOPORT_H_

/* change this to use another GPIO port */
#define GPIO_PORT DT_ALIAS_SW0_GPIOS_CONTROLLER

/* change this to use another GPIO pin */
#define BTN_GPIO_PIN DT_ALIAS_SW0_GPIOS_PIN

/* change to use another GPIO pin interrupt config */
#define GPIO_EDGE (DT_ALIAS_SW0_GPIOS_FLAGS | GPIO_INT_EDGE)

/* change this to enable pull-up/pull-down */
#define GPIO_PULL_UP DT_ALIAS_SW0_GPIOS_FLAGS

#endif // __BIOPORT_H_
```

## src/ble.c
```c
#include "ble.h"

static const struct bt_data ad[] = {
    BT_DATA_BYTES(BT_DATA_FLAGS, (BT_LE_AD_GENERAL | BT_LE_AD_NO_BREDR)),
    BT_DATA_BYTES(BT_DATA_UUID16_ALL, 0x12, 0x18, /* HID Service */
                  0x0f, 0x18),                    /* Battery Service */
};

static struct bt_conn_cb conn_callbacks = {
    .connected = connected,
    .disconnected = disconnected,
    .security_changed = security_changed,
};

static struct bt_conn_auth_cb auth_cb_display = {
    .passkey_display = auth_passkey_display,
    .passkey_entry = NULL,
    .cancel = auth_cancel,
};

void connected(struct bt_conn *conn, u8_t err) {
  char addr[BT_ADDR_LE_STR_LEN];

  bt_addr_le_to_str(bt_conn_get_dst(conn), addr, sizeof(addr));

  if (err) {
    printk("Failed to connect to %s (%u)\n", addr, err);
    return;
  }

  printk("Connected %s\n", addr);

  if (bt_conn_set_security(conn, BT_SECURITY_L2)) {
    printk("Failed to set security\n");
  }
}

void disconnected(struct bt_conn *conn, u8_t reason) {
  char addr[BT_ADDR_LE_STR_LEN];

  bt_addr_le_to_str(bt_conn_get_dst(conn), addr, sizeof(addr));

  printk("Disconnected from %s (reason 0x%02x)\n", addr, reason);
}

void security_changed(struct bt_conn *conn, bt_security_t level,
                      enum bt_security_err err) {
  char addr[BT_ADDR_LE_STR_LEN];

  bt_addr_le_to_str(bt_conn_get_dst(conn), addr, sizeof(addr));

  if (!err) {
    printk("Security changed: %s level %u", addr, level);
  } else {
    printk("Security failed: %s level %u err %d", addr, level, err);
  }
}

void bt_ready(int err) {
  if (err) {
    printk("Bluetooth init failed (err %d)\n", err);
    return;
  }

  printk("Bluetooth initialized\n");

  if (IS_ENABLED(CONFIG_SETTINGS)) {
    printk("Sam3\n");
    settings_load();
  }

  err = bt_le_adv_start(BT_LE_ADV_CONN_NAME, ad, ARRAY_SIZE(ad), NULL, 0);
  if (err) {
    printk("Advertising failed to start (err %d)\n", err);
    return;
  }

  printk("Advertising successfully started\n");
}

void auth_passkey_display(struct bt_conn *conn, unsigned int passkey) {
  char addr[BT_ADDR_LE_STR_LEN];

  bt_addr_le_to_str(bt_conn_get_dst(conn), addr, sizeof(addr));

  printk("Passkey for %s: %06u\n", addr, passkey);
}

void auth_cancel(struct bt_conn *conn) {
  char addr[BT_ADDR_LE_STR_LEN];

  bt_addr_le_to_str(bt_conn_get_dst(conn), addr, sizeof(addr));

  printk("Pairing cancelled: %s\n", addr);
}

void ble_init() {
  int err;
  struct bt_le_conn_param param;

  printk("Sam1\n");
  err = bt_enable(bt_ready);
  if (err) {
    printk("Bluetooth init failed (err %d)\n", err);
    return;
  }
  printk("Sam2\n");

  param.interval_min = 10;
  param.interval_max = 50;
  param.latency = 0;
  param.timeout = 400;

  err = bt_conn_le_param_update(NULL, &param);

  bt_conn_cb_register(&conn_callbacks);
  bt_conn_auth_cb_register(&auth_cb_display);
}
```

## src/ble.h
```c
#ifndef __BLE_H_
#define __BLE_H_

#include <bluetooth/bluetooth.h>
#include <bluetooth/conn.h>
#include <bluetooth/gatt.h>
#include <bluetooth/hci.h>
#include <bluetooth/uuid.h>

#include <settings/settings.h>

void connected(struct bt_conn *conn, u8_t err);
void disconnected(struct bt_conn *conn, u8_t reason);
void security_changed(struct bt_conn *conn, bt_security_t level,
                      enum bt_security_err err);
void bt_ready(int err);
void auth_passkey_display(struct bt_conn *conn, unsigned int passkey);
void auth_cancel(struct bt_conn *conn);

void ble_init();

#endif // __BLE_H_
```

## src/button.c
```c
#include "button.h"

static void button_pressed(struct device *gpio_dev, struct gpio_callback *cb,
                           u32_t pins) {
  // mouse_notify();
  printk("Button pressed at %" PRIu32 "\n", k_cycle_get_32());
}

void button_init(struct device *gpio_dev) {
  struct gpio_callback *gpio_cb;

  gpio_pin_configure(gpio_dev, BTN_GPIO_PIN,
                     GPIO_DIR_IN | GPIO_INT | GPIO_PULL_UP | GPIO_EDGE);

  gpio_init_callback(gpio_cb, button_pressed, BIT(BTN_GPIO_PIN));

  gpio_add_callback(gpio_dev, gpio_cb);
  gpio_pin_enable_callback(gpio_dev, BTN_GPIO_PIN);
}
```

## src/button.h
```c
#ifndef __BUTTON_H_
#define __BUTTON_H_

#include <device.h>
#include <drivers/gpio.h>
#include <zephyr.h>

#include "bioport.h"
#include "mouse.h"

void button_init(struct device *gpio_dev);

#endif // __BUTTON_H_
```

## src/mouse.c
```c
/** @file
 *  @brief mouse Service sample
 */

/*
 * Copyright (c) 2016 Intel Corporation
 *
 * SPDX-License-Identifier: Apache-2.0
 */

#include <errno.h>
#include <stddef.h>
#include <string.h>
#include <sys/byteorder.h>
#include <sys/printk.h>
#include <zephyr.h>
#include <zephyr/types.h>

#include <bluetooth/bluetooth.h>
#include <bluetooth/conn.h>
#include <bluetooth/gatt.h>
#include <bluetooth/hci.h>
#include <bluetooth/uuid.h>

#include <usb/usb_device.h>
#include <usb/class/usb_hid.h>

#include "mouse.h"

enum {
  HIDS_REMOTE_WAKE = BIT(0),
  HIDS_NORMALLY_CONNECTABLE = BIT(1),
};

struct hids_info {
  u16_t version; /* version number of base USB HID Specification */
  u8_t code;     /* country HID Device hardware is localized for. */
  u8_t flags;
} __packed;

struct hids_report {
  u8_t id;   /* report id */
  u8_t type; /* report type */
} __packed;

static struct hids_info info = {
    .version = 0x0000,
    .code = 0x00,
    .flags = HIDS_NORMALLY_CONNECTABLE,
};

enum {
  HIDS_INPUT = 0x01,
  HIDS_OUTPUT = 0x02,
  HIDS_FEATURE = 0x03,
};

static struct hids_report input = {
    .id = 0x01,
    .type = HIDS_INPUT,
};

#define BCNT 3

static u8_t simulate_input;
static u8_t ctrl_point;
static u8_t report_map[] = {
    HID_GI_USAGE_PAGE,     USAGE_GEN_DESKTOP,
    HID_LI_USAGE,          USAGE_GEN_DESKTOP_MOUSE,
    HID_MI_COLLECTION,     COLLECTION_APPLICATION,
      HID_LI_USAGE,          USAGE_GEN_DESKTOP_POINTER,
      HID_MI_COLLECTION,     COLLECTION_PHYSICAL,
        HID_GI_USAGE_PAGE,     USAGE_GEN_BUTTON,
        HID_LI_USAGE_MIN(1),   1,
        HID_LI_USAGE_MAX(1),   BCNT,
        HID_GI_LOGICAL_MIN(1), 0,
        HID_GI_LOGICAL_MAX(1), 1,
        HID_GI_REPORT_SIZE,    1,
        HID_GI_REPORT_COUNT,   BCNT,
        HID_MI_INPUT,          0x02,
        HID_GI_REPORT_SIZE,    (8 - BCNT),
        HID_GI_REPORT_COUNT,   1,

        HID_MI_INPUT,          0x03,
        HID_GI_USAGE_PAGE,     USAGE_GEN_DESKTOP,
        HID_LI_USAGE,          USAGE_GEN_DESKTOP_X,
        HID_LI_USAGE,          USAGE_GEN_DESKTOP_Y,
        /* HID_LI_USAGE,          USAGE_GEN_DESKTOP_WHEEL, */
        HID_GI_LOGICAL_MIN(2), 0x01, 0x80, /* 2s comp -32767 */
        HID_GI_LOGICAL_MAX(2), 0xff, 0x7f, /* 2s comp 32767 */
        /* HID_GI_LOGICAL_MIN(2), 0xfe, 0x0c, /\* 2s comp -32767 *\/ */
        /* HID_GI_LOGICAL_MAX(2), 0xf4, 0x01, /\* 2s comp 32767 *\/ */
        HID_GI_REPORT_SIZE,    16,
        HID_GI_REPORT_COUNT,   2,
        HID_MI_INPUT,          0x06,
        /* HID_MI_INPUT,          0x02, */
      HID_MI_COLLECTION_END,
    HID_MI_COLLECTION_END,
};

static ssize_t read_info(struct bt_conn *conn, const struct bt_gatt_attr *attr,
                         void *buf, u16_t len, u16_t offset) {
  return bt_gatt_attr_read(conn, attr, buf, len, offset, attr->user_data,
                           sizeof(struct hids_info));
}

static ssize_t read_report_map(struct bt_conn *conn,
                               const struct bt_gatt_attr *attr, void *buf,
                               u16_t len, u16_t offset) {
  return bt_gatt_attr_read(conn, attr, buf, len, offset, report_map,
                           sizeof(report_map));
}

static ssize_t read_report(struct bt_conn *conn,
                           const struct bt_gatt_attr *attr, void *buf,
                           u16_t len, u16_t offset) {
  return bt_gatt_attr_read(conn, attr, buf, len, offset, attr->user_data,
                           sizeof(struct hids_report));
}

static void input_ccc_changed(const struct bt_gatt_attr *attr, u16_t value) {
  simulate_input = (value == BT_GATT_CCC_NOTIFY) ? 1 : 0;
}

static ssize_t read_input_report(struct bt_conn *conn,
                                 const struct bt_gatt_attr *attr, void *buf,
                                 u16_t len, u16_t offset) {
  return bt_gatt_attr_read(conn, attr, buf, len, offset, NULL, 0);
}

static ssize_t write_ctrl_point(struct bt_conn *conn,
                                const struct bt_gatt_attr *attr,
                                const void *buf, u16_t len, u16_t offset,
                                u8_t flags) {
  u8_t *value = attr->user_data;

  if (offset + len > sizeof(ctrl_point)) {
    return BT_GATT_ERR(BT_ATT_ERR_INVALID_OFFSET);
  }

  memcpy(value + offset, buf, len);

  return len;
}

/* HID Service Declaration */
BT_GATT_SERVICE_DEFINE(
    mouse_svc, BT_GATT_PRIMARY_SERVICE(BT_UUID_HIDS),
    BT_GATT_CHARACTERISTIC(BT_UUID_HIDS_INFO, BT_GATT_CHRC_READ,
                           BT_GATT_PERM_READ, read_info, NULL, &info),
    BT_GATT_CHARACTERISTIC(BT_UUID_HIDS_REPORT_MAP, BT_GATT_CHRC_READ,
                           BT_GATT_PERM_READ, read_report_map, NULL, NULL),
    BT_GATT_CHARACTERISTIC(BT_UUID_HIDS_REPORT,
                           BT_GATT_CHRC_READ | BT_GATT_CHRC_NOTIFY,
                           BT_GATT_PERM_READ_AUTHEN, read_input_report, NULL,
                           NULL),
    BT_GATT_CCC(input_ccc_changed,
                BT_GATT_PERM_READ_AUTHEN | BT_GATT_PERM_WRITE_AUTHEN),
    BT_GATT_DESCRIPTOR(BT_UUID_HIDS_REPORT_REF, BT_GATT_PERM_READ, read_report,
                       NULL, &input),
    BT_GATT_CHARACTERISTIC(BT_UUID_HIDS_CTRL_POINT,
                           BT_GATT_CHRC_WRITE_WITHOUT_RESP, BT_GATT_PERM_WRITE,
                           NULL, write_ctrl_point, &ctrl_point), );

void serialize(struct mouse_status *status) {
  status->packet[0] = (s8_t)status->button;
  status->packet[1] = (s8_t)(status->pos[0]);
  status->packet[2] = (s8_t)(status->pos[0] >> 8);
  status->packet[3] = (s8_t)(status->pos[1]);
  status->packet[4] = (s8_t)(status->pos[1] >> 8);
}
/* void serialize(struct mouse_status *status) { */
/*   status->packet[0] = (s8_t)status->button; */
/*   status->packet[1] = 0x7f; */
/*   status->packet[2] = 0x7f; */
/*   status->packet[3] = 0x7f; */
/*   status->packet[4] = 0x7f; */
/* } */

void print_packet(struct mouse_status *status) {
  int i;
  for(i=0; i<sizeof(status->packet); i+=1) {
    printk("%x ",status->packet[i]);
  }
  printk("\n\n");
}

void mouse_init(void) {}

int mouse_notify(struct mouse_status *status) {
  int rc;
  static s8_t mouse[5];

  serialize(status);
  /* printk("%i %i\n", status->pos[0], status->pos[1]); */
  print_packet(status);

  rc = bt_gatt_notify(NULL, &mouse_svc.attrs[4], status->packet, sizeof(status->packet));

  return rc == -ENOTCONN ? 0 : rc;
}
```

## src/mouse.h
```c
/** @file
 *  @brief mouse Service sample
 */

/*
 * Copyright (c) 2016 Intel Corporation
 *
 * SPDX-License-Identifier: Apache-2.0
 */

#ifdef __cplusplus
extern "C" {
#endif

#define MOUSE_BTN_REPORT_POS 0
#define MOUSE_X_REPORT_POS 0
#define MOUSE_Y_REPORT_POS 1

#define MOUSE_BTN_LEFT BIT(0)
#define MOUSE_BTN_RIGHT BIT(1)
#define MOUSE_BTN_MIDDLE BIT(2)

struct mouse_status {
  u8_t button;
  s16_t pos[2];
  s8_t packet[5];
  unsigned packet_sz;
};

void mouse_init(void);
int mouse_notify(struct mouse_status *status);

#ifdef __cplusplus
}
#endif
```

## src/mpu.c
```c
#include "mpu.h"
#include "mouse.h"
#include "sensor.h"
#include "zephyr/types.h"
#include <string.h>
#include <stdlib.h>
#include <math.h>

static const int MPU_RES = 65536;
static const int X_RES = 65536;
static const int Y_RES = 65536;
static const int Z_RES = 65536;
static const int X_MAX_ROT_INT_PT = 10;
static const int Y_MAX_ROT_INT_PT = 10;
static const int Z_MAX_ROT_INT_PT = 10;
/* static const int INT_STPS = 3; */
static const int FRAC_RES = 10000000;
static const int M_PI = 3.14159;

static float X_PIX_PER_INT_DIV, Y_PIX_PER_INT_DIV, Z_PIX_PER_INT_DIV;
static float X_PIX_PER_FRAC_DIV, Y_PIX_PER_FRAC_DIV, Z_PIX_PER_FRAC_DIV;
static float X_DIV_PER_PIX, Y_DIV_PER_PIX;
static struct sensor_value prev_val[3];
static struct sensor_value center_val[3];
static bool start = true;
static int int_cnt = 0;

struct mpu_t {
  s16_t gyro[3];
  s16_t acc[3];
};

static struct sensor_trigger acc_trig = {
    .type = SENSOR_TRIG_DATA_READY,
    .chan = SENSOR_CHAN_ACCEL_XYZ,
};
static struct sensor_trigger gyro_trig = {
    .type = SENSOR_TRIG_DATA_READY,
    .chan = SENSOR_CHAN_GYRO_XYZ,
};

inline float GET_PIX_PER_DIV(const int res, const int max_divs) {
  return (float)res / 2 / max_divs;
}

bool read_channel(struct device *dev, struct sensor_value *val, unsigned int channel) {
  float dval[3];
  int ret;

  ret = sensor_channel_get(dev, channel, val);
  if (ret < 0) {
    printk("Cannot read sensor channels");
    return false;
  }

  if (val[0].val1 != 0 || val[1].val1 != 0 || val[2].val1 != 0)
    return true;
  return false;
}

void get_printable_sensor_str(struct sensor_value channel, char *out,
                              size_t sz) {
  if ((channel.val1 < 0) || (channel.val2 < 0)) {
    snprintk(out, sz, "-%u.%u", -channel.val1, -channel.val2);
  } else {
    snprintk(out, sz, "%u.%u", channel.val1, channel.val2);
  }
  return;
}

void print_sensor(struct sensor_value *val) {

  printk("X: %i.%i\nY: %i.%i\nZ: %i.%i\n", val[0].val1, val[0].val2,
         val[1].val1, val[1].val2, val[2].val1, val[2].val2);
}

/* void scale_2_u16(struct sensor_value *val, s16_t *scaled) { */
/*   s32_t x, y, z; */

/*   x = ((val[0].val1 - center_val[0].val1) * X_PIX_PER_INT_DIV) + */
/*       ((val[0].val2 - center_val[0].val2) * X_PIX_PER_FRAC_DIV); */
/*   scaled[0] = (s16_t)val[0].val1 / X_DIV_PER_PIX; */
/*   scaled[0] *= 1.5; */
/*   /\* printk("x: %i\n", x); *\/ */

/*   y = ((val[1].val1 - center_val[1].val1) * Y_PIX_PER_INT_DIV) + */
/*       ((val[1].val2 - center_val[1].val2) * Y_PIX_PER_FRAC_DIV); */
/*   scaled[1] = (s16_t)val[1].val1 / Y_DIV_PER_PIX; */
/*   scaled[1] *= 1.5; */
/*   /\* printk("y: %i\n", y); *\/ */

/*   z = ((val[2].val1 - center_val[2].val1) * Z_PIX_PER_INT_DIV) + */
/*       ((val[2].val2 - center_val[2].val2) * Z_PIX_PER_FRAC_DIV); */
/*   scaled[2] = (s16_t)val[2].val1; */
/*   scaled[2] *= 1.5; */
/*   /\* printk("z: %i\n", z); *\/ */
/* } */

void sensor_2_u16(struct sensor_value *val, s16_t *scaled) {
  s32_t x, y, z;

  scaled[0] = (s16_t)val[0].val1;
  /* printk("x: %i\n", x); */

  scaled[1] = (s16_t)val[1].val1;
  /* printk("y: %i\n", y); */

  /* z = ((val[2].val1 - center_val[2].val1) * Z_PIX_PER_INT_DIV) + */
  /*     ((val[2].val2 - center_val[2].val2) * Z_PIX_PER_FRAC_DIV); */
  /* scaled[2] = (s16_t)val[2].val1; */
  scaled[2] = (s16_t)val[2].val1;
  /* printk("z: %i\n", z); */
}

void set_mouse_pos(struct mpu_t *mpu, struct mouse_status *ms) {
  ms->pos[0] = mpu->gyro[0];
  ms->pos[1] = mpu->gyro[1];
}

void copy_sensor_val(struct sensor_value *from, struct sensor_value *to) {
  int i;

  for (i = 0; i < 3; i += 1) {
    to[i].val1 = from[i].val1;
    to[i].val2 = from[i].val2;
  }
}

/* void complementary_filter(struct mpu_t *mpu) { */
/*   float pitch, roll, pitchAcc, rollAcc; */
/*   float dt = .1; */

/*   // Integrate the gyroscope data -> int(angularSpeed) = angle */
/*   pitch += (float)mpu->gyro[0] * dt; // Angle around the X-axis */
/*   roll -= (float)mpu->gyro[1] * dt; // Angle around the Y-axis */

/*   // Compensate for drift with accelerometer data if !bullshit */
/*   // Sensitivity = -2 to 2 G at 16Bit -> 2G = 32768 && 0.5G = 8192 */
/*   int forceMagnitudeApprox = */
/*       abs(mpu->acc[0]) + abs(mpu->acc[1]) + abs(mpu->acc[2]); */
/*   if (forceMagnitudeApprox > 8192 && forceMagnitudeApprox < 32768) { */
/*     // Turning around the X axis results in a vector on the Y-axis */
/*     pitchAcc = tan((float)mpu->acc[1], (float)mpu->acc[2]) * 180 / M_PI; */
/*     pitch = pitch * 0.98 + pitchAcc * 0.02; */

/*     // Turning around the Y axis results in a vector on the X-axis */
/*     rollAcc = atan2f((float)mpu->acc[0], (float)mpu->acc[2]) * 180 / M_PI; */
/*     roll = roll * 0.98 + rollAcc * 0.02; */
/*   } */

/*   mpu->gyro[0] = pitch; */
/*   mpu->gyro[1] = roll; */
/* } */

/* void mpu_filter(struct mpu_t *mpu) { */
/*   complementary_filter(mpu); */
/* } */

void mpu_print(struct mpu_t *mpu) {
  printk("gyro: x: %i\ny: %i\nz: %i\n", mpu->gyro[0],mpu->gyro[1],mpu->gyro[2]);
}

/* void pre_filter_gyro(struct sensor_value *gyro_val) {} */

void center(struct sensor_value *gyro) {
	int i;
	for(i=0; i<3; i+=1) {
		gyro[i].val1 -= center_val[i].val1;
		gyro[i].val2 -= center_val[i].val2;
	}
}

void scale(s16_t *gyro) {
	gyro[0] /= 1000;
	gyro[1] /= 1000;
	gyro[2] /= 1000;
}

void gyro_handler(struct device *dev, struct sensor_trigger *tr) {
  struct mpu_t mpu;
  struct sensor_value gyro_raw[3];
  struct sensor_value acc_raw[3];
  struct mouse_status ms;
	/* struct mpu6050_data *drv_data = dev->driver_data; */

  ARG_UNUSED(tr);

  /* k_sleep(MSEC_PER_SEC); */

  /* Always fetch the sample to clear the data ready interrupt in the
   * sensor.
   */
  if (sensor_sample_fetch(dev)) {
    printk("sensor_sample_fetch failed");
    return;
  }

  /* printk("raw: %i\n",drv_data->gyro_x); */
  read_channel(dev, gyro_raw, SENSOR_CHAN_GYRO_XYZ);
  /* print_sensor(gyro_raw); */
  /* read_channel(dev, acc_raw, SENSOR_CHAN_ACCEL_XYZ); */
  if (start) {
    k_sleep(MSEC_PER_SEC);
    read_channel(dev, gyro_raw, SENSOR_CHAN_GYRO_XYZ);
    copy_sensor_val(gyro_raw, center_val);
    start = false;
    goto finish;
  }
  center(gyro_raw);
  sensor_2_u16(gyro_raw, mpu.gyro);
  scale(mpu.gyro);
  /* mpu_print(&mpu); */
  /* scale_2_u16(acc_raw, mpu.acc); */
  /* mpu_filter(&mpu); */

  set_mouse_pos(&mpu, &ms);
  ms.button = 0;
  mouse_notify(&ms);
finish:
  /* int_cnt = (int_cnt + 1) % INT_STPS; */
  return;
}

/* void acc_handler(struct device *dev, struct sensor_trigger *tr) { */
/*   struct sensor_value val[3]; */
/*   struct mouse_status ms; */

/*   ARG_UNUSED(tr); */

/*   k_sleep(MSEC_PER_SEC); */

/*   /\* Always fetch the sample to clear the data ready interrupt in the */
/*    * sensor. */
/*    *\/ */
/*   if (sensor_sample_fetch(dev)) { */
/*     printk("sensor_sample_fetch failed"); */
/*     return; */
/*   } */

/*   read_sensor(dev, val, SENSOR_CHAN_ACCEL_XYZ); */
/*   print_sensor(val); */
/*   if (start) { */
/*     k_sleep(MSEC_PER_SEC); */
/*     read_gyro(dev, val); */
/*     copy_sensor_val(val, center_val); */
/*     start = false; */
/*     goto finish; */
/*   } */
/*   set_mouse_pos(val, ms.pos); */
/*   ms.button = 0; */
/*   /\* ms.position = mouse_pos; *\/ */
/*   /\* printk("dx %i dy %i\n", ms.pos[MOUSE_X_REPORT_POS], *\/ */
/*   /\*        ms.pos[MOUSE_Y_REPORT_POS]); *\/ */
/*   mouse_notify(&ms); */
/* finish: */
/*   /\* int_cnt = (int_cnt + 1) % INT_STPS; *\/ */
/*   return; */
/* } */

bool read_temp(struct device *dev) {
  struct sensor_value val;
  char ts[16];
  int ret;

  get_printable_sensor_str(val, ts, sizeof(ts));
  ret = sensor_channel_get(dev, SENSOR_CHAN_DIE_TEMP, &val);
  if (ret < 0) {
    printk("Cannot read sensor channels");
    return false;
  }
  // printk("temp: %s\n", ts);

  return true;
}

void mpu_init(struct device *mpu_dev) {
  X_PIX_PER_INT_DIV = GET_PIX_PER_DIV(X_RES, X_MAX_ROT_INT_PT);
  Y_PIX_PER_INT_DIV = GET_PIX_PER_DIV(Y_RES, Y_MAX_ROT_INT_PT);
  Z_PIX_PER_INT_DIV = GET_PIX_PER_DIV(Z_RES, Z_MAX_ROT_INT_PT);
  X_PIX_PER_FRAC_DIV = GET_PIX_PER_DIV(X_RES, X_MAX_ROT_INT_PT * FRAC_RES);
  Y_PIX_PER_FRAC_DIV = GET_PIX_PER_DIV(Y_RES, Y_MAX_ROT_INT_PT * FRAC_RES);
  Z_PIX_PER_FRAC_DIV = GET_PIX_PER_DIV(Z_RES, Z_MAX_ROT_INT_PT * FRAC_RES);
  X_DIV_PER_PIX = MPU_RES / 1920;
  Y_DIV_PER_PIX = MPU_RES / 1080;

  if (sensor_trigger_set(mpu_dev, &gyro_trig, gyro_handler)) {
    printk("Could not set trigger");
    return;
  }
}
```

## src/mpu.h
```c
#ifndef __MPU_H_
#define __MPU_H_

#include <drivers/sensor.h>

#define X_SCALE 10
#define Y_SCALE 10

void get_printable_sensor_str(struct sensor_value channel, char *out,
                              size_t sz);
bool read_gyro(struct device *dev, struct sensor_value *val);
void gyro_handler(struct device *dev, struct sensor_trigger *tr);
bool read_temp(struct device *dev);
void mpu_init();

#endif // __MPU_H_
```
